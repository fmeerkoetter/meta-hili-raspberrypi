## conf/layer.conf
```bitbake
# We have a conf and classes directory, add to BBPATH
BBPATH .= ":${LAYERDIR}"

# We have recipes-* directories, add to BBFILES
BBFILES += "${LAYERDIR}/recipes-*/*/*.bb \
	${LAYERDIR}/recipes-*/*/*.bbappend"

BBFILE_COLLECTIONS += "meta-hili-raspberrypi"
BBFILE_PATTERN_meta-hili-raspberrypi = "^${LAYERDIR}/"
BBFILE_PRIORITY_meta-hili-raspberrypi = "6"
```
